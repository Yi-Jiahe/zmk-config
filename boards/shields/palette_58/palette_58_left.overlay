#include "palette_58.dtsi" // The shared dtsi file is included in the overlay

// Label of the kscan node in the dtsi
&kscan0 {
    row-gpios
      = <&gpio0 22 (GPIO_ACTIVE_HIGH | GPIO_PULL_DOWN)>
      , <&gpio0 24 (GPIO_ACTIVE_HIGH | GPIO_PULL_DOWN)>
      , <&gpio1 00 (GPIO_ACTIVE_HIGH | GPIO_PULL_DOWN)>
      , <&gpio0 11 (GPIO_ACTIVE_HIGH | GPIO_PULL_DOWN)>
      , <&gpio1 04 (GPIO_ACTIVE_HIGH | GPIO_PULL_DOWN)>
      ;
      
    col-gpios
      = <&gpio0 31 (GPIO_ACTIVE_HIGH | GPIO_PULL_DOWN)>
      , <&gpio0 29 (GPIO_ACTIVE_HIGH | GPIO_PULL_DOWN)>
      , <&gpio0 02 (GPIO_ACTIVE_HIGH | GPIO_PULL_DOWN)>
      , <&gpio1 15 (GPIO_ACTIVE_HIGH | GPIO_PULL_DOWN)>
      , <&gpio1 13 (GPIO_ACTIVE_HIGH | GPIO_PULL_DOWN)>
      , <&gpio1 11 (GPIO_ACTIVE_HIGH | GPIO_PULL_DOWN)>
      ;
};