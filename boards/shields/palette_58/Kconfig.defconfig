## boards/shields/palette_58/Kconfig.defconfig
```kconfig
if SHIELD_PALETTE_58_LEFT

# Name must be less than 16 characters long!
config ZMK_KEYBOARD_NAME
    default "Palette 58"

config ZMK_SPLIT_ROLE_CENTRAL
    default y

endif

if SHIELD_PALETTE_58_LEFT || SHIELD_PALETTE_58_RIGHT

config ZMK_SPLIT
    default y

endif

if ZMK_DISPLAY

config I2C
    default y

config SSD1306
    default y

endif # ZMK_DISPLAY
```

## boards/shields/palette_58/Kconfig.shield
```kconfig
# No whitespace after the comma or in your part name!
config SHIELD_PALETTE_58_LEFT
    def_bool $(shields_list_contains,palette_58_left)

# No whitespace after the comma or in your part name!
config SHIELD_PALETTE_58_RIGHT
    def_bool $(shields_list_contains,palette_58_right)
```

## boards/shields/tenta_one/Kconfig.defconfig
```kconfig
if SHIELD_TENTA_ONE

# Name must be less than 16 characters long!
config ZMK_KEYBOARD_NAME
    default "Tenta One"

endif
```

## boards/shields/tenta_one/Kconfig.shield
```kconfig
# No whitespace after the comma or in your keyboard name!
config SHIELD_TENTA_ONE
    def_bool $(shields_list_contains,tenta_one)
    
```

## module/drivers/radial_menu/Kconfig
```kconfig
menuconfig RADIAL_MENU
  bool "2-Axis Joystick Radial Menu"
  depends on ADC
  help
    Enable driver for 2-Axis Joystick Radial Menu

if RADIAL_MENU
  # Other configs
  # Trigger?
  # Log
endif
  
```

## module/dts/bindings/radial_menu.yaml
```yaml
description: |
  Driver for a radial menu for a 2-axis joystick

compatible: "radial_menu"

properties:
  x-gpio:
    type: phandle
    required: true
    description: Analog pin for the x-axis
  y-gpio:
    type: phandle
    required: true
    description: Analog pin for the y-axis
```
